## arch/arm/mach-msm/htc/shooteru/Kconfig
```kconfig
config BOARD_HEADER_FILE
	string "HTC board specific header file name"
	default ""

config MACH_SHOOTERU
	depends on ARCH_MSM8X60
	select MACH_HTC
        select REMOVE_SMI_2X_CLK
	bool "HTC Shooteru"
	help
	  Support for the HTC SHOOTERU device.
```
